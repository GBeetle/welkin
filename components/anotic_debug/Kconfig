## components/anotic_debug/Kconfig
```kconfig
menu "anotic_debug"

config ANOTIC_DEBUG
    bool "enable anotic debug tools"
    default "y"

endmenu
```

## components/bmp280/Kconfig
```kconfig
menu "bmp280"

config BMP280
    bool "enable bmp280 driver"
    default "y"

endmenu
```

## components/error_handle/Kconfig
```kconfig
menu "error handle"

config ERROR_HANDLE
    bool "enable error handle system"
    default "y"

endmenu
```

## components/i2c_bus/Kconfig
```kconfig
menu "i2c_bus"

config MPU_I2C
    bool "enable mpu i2c"
    default "n"

config BMP_I2C
    bool "enable bmp280 i2c"
    default "n"

endmenu
```

## components/io_define/Kconfig
```kconfig
menu "io define"

config IO_DEFINE
    bool "enable io define"
    default "y"

endmenu
```

## components/isr_manager/Kconfig
```kconfig
menu "isr manager"

config ISR_MANAGER
    bool "enable isr manager"
    default "y"

endmenu
```

## components/lis3mdl/Kconfig
```kconfig
menu "lis3mdl"

    config LIS3MDL
        bool "enable magnetic lis3mdl"
        default "n"
    
endmenu
```

## components/log_sys/Kconfig
```kconfig
menu "log_system"

config LOG_SYSTEM
    bool "enable log system"
    default "y"

endmenu
```

## components/mpu_driver/Kconfig
```kconfig
menu "mpu_driver"

    config MPU6500
        bool "enable mpu6500"
        default "n"

    config MPU6050
        bool "enable mpu6050"
        default "y"

endmenu
```

## components/spi_bus/Kconfig
```kconfig
menu "spi_bus"

    config MPU_SPI
        bool "enable mpu spi"
        default "y"

    config BMP_SPI
        bool "enable bmp280 spi"
        default "y"

    config NRF24_SPI
        bool "enable nrf24 spi"
        default "y"

endmenu
```

## components/task_manager/Kconfig
```kconfig
menu "task manager"

config TASK_MANAGER
    bool "enable task manager"
    default "y"

endmenu
```
